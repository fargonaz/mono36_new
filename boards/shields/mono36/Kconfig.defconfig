## boards/shields/mono36/Kconfig.defconfig
```kconfig
# Copyright (c) 2023 The ZMK Contributors
# SPDX-License-Identifier: MIT

if SHIELD_MONO36_NEW

config ZMK_KEYBOARD_NAME
    default "MONO36_NEW"




endif
```

## boards/shields/mono36/Kconfig.shield
```kconfig
# Copyright (c) 2023 The ZMK Contributors
# SPDX-License-Identifier: MIT

config SHIELD_MONO36_NEW
    def_bool $(shields_list_contains,mono36_new)
```
